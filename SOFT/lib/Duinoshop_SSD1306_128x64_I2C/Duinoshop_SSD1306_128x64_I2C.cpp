/*********************************************************************
This is a library for our Monochrome OLEDs based on SSD1306 drivers
*********************************************************************/
#include <Wire.h>

#include "Duinoshop_SSD1306_128x64_I2C.h"

#define ssd1306_swap(a, b) \
   {                       \
      int16_t t = a;       \
      a = b;               \
      b = t;               \
   }

static int8_t _i2caddr;

// the memory buffer for the LCD

static unsigned char buffer[] = {
    0x00, 0x00, 0x00, 0x00, 0x00, 0x00, 0x00, 0x00, 0x00, 0x00, 0x00, 0x00, 0x00, 0x00, 0x00, 0x00,
    0x00, 0x00, 0x00, 0x00, 0x00, 0x00, 0x00, 0x00, 0x00, 0x00, 0x00, 0x00, 0x00, 0x00, 0x00, 0x00,
    0x00, 0x00, 0x00, 0x00, 0x00, 0x00, 0x00, 0x00, 0x00, 0x00, 0x00, 0x00, 0x00, 0x00, 0x00, 0x00,
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    0x00, 0x00, 0x00, 0x00, 0x00, 0x00, 0x00, 0x00, 0x00, 0x00, 0x00, 0x00, 0x00, 0x00, 0x00, 0x00};

// initializer for I2C - we only indicate the reset pin!
DuinoShop_SSD1306::DuinoShop_SSD1306() : Adafruit_GFX(SSD1306_LCDWIDTH, SSD1306_LCDHEIGHT)
{
}

void DuinoShop_SSD1306::begin(uint8_t i2caddr)
{
   _i2caddr = i2caddr;

   // I2C Init
   Wire.begin();

   // Init sequence for 128x64 OLED module
   command(SSD1306_DISPLAYOFF);         // 0xAE
   command(SSD1306_SETDISPLAYCLOCKDIV); // 0xD5
   command(0x80);                       // the suggested ratio 0x80
   command(SSD1306_SETMULTIPLEX);       // 0xA8
   command(0x3F);
   command(SSD1306_SETDISPLAYOFFSET);   // 0xD3
   command(0x0);                        // no offset
   command(SSD1306_SETSTARTLINE | 0x0); // line #0
   command(SSD1306_CHARGEPUMP);         // 0x8D
                                        /*if (vccstate == SSD1306_EXTERNALVCC)
                                           command(0x10);
                                        else*/
   command(0x14);
   command(SSD1306_MEMORYMODE); // 0x20
   command(0x00);               // 0x0 act like ks0108
   command(SSD1306_SEGREMAP | 0x1);
   command(SSD1306_COMSCANDEC);
   command(SSD1306_SETCOMPINS); // 0xDA
   command(0x12);
   command(SSD1306_SETCONTRAST); // 0x81
                                 /*if (vccstate == SSD1306_EXTERNALVCC)
                                    command(0x9F);
                                 else*/
   command(0xCF);
   command(SSD1306_SETPRECHARGE); // 0xd9
                                  /* if (vccstate == SSD1306_EXTERNALVCC)
                                      command(0x22);
                                   else*/
   command(0xF1);
   command(SSD1306_SETVCOMDETECT); // 0xDB
   command(0x40);
   command(SSD1306_DISPLAYALLON_RESUME); // 0xA4
   command(SSD1306_NORMALDISPLAY);       // 0xA6

   command(SSD1306_DISPLAYON); //--turn on oled panel
}

void DuinoShop_SSD1306::command(uint8_t c)
{
   // I2C
   uint8_t control = 0x00; // Co = 0, D/C = 0
   Wire.beginTransmission(_i2caddr);
   Wire.write(control);
   Wire.write(c);
   Wire.endTransmission();
}

void DuinoShop_SSD1306::display(void)
{
   command(SSD1306_COLUMNADDR);
   command(0);                    // Column start address (0 = reset)
   command(SSD1306_LCDWIDTH - 1); // Column end address (127 = reset)

   command(SSD1306_PAGEADDR);
   command(0); // Page start address (0 = reset)

   command(7); // Page end address

   // I2C
   for (uint16_t i = 0; i < (SSD1306_LCDWIDTH * SSD1306_LCDHEIGHT / 8); i++)
   {
      // send a bunch of data in one xmission
      Wire.beginTransmission(_i2caddr);
      Wire.write(0x40);
      for (uint8_t x = 0; x < 16; x++)
      {
         Wire.write(buffer[i]);
         i++;
      }
      i--;
      Wire.endTransmission();
   }
}

// clear everything
void DuinoShop_SSD1306::clearDisplay(void)
{
   memset(buffer, 0, (SSD1306_LCDWIDTH * SSD1306_LCDHEIGHT / 8));
}

void DuinoShop_SSD1306::invertDisplay(bool invert)
{
   if (invert)
   {
      command(SSD1306_INVERTDISPLAY);
   }
   else
   {
      command(SSD1306_NORMALDISPLAY);
   }
}

// the most basic function, set a single pixel
void DuinoShop_SSD1306::drawPixel(int16_t x, int16_t y, uint16_t color)
{
   if ((x < 0) || (x >= SSD1306_LCDWIDTH) || (y < 0) || (y >= SSD1306_LCDHEIGHT))
      return;

   // x is which column
   switch (color)
   {
   case WHITE:
      buffer[x + (y / 8) * SSD1306_LCDWIDTH] |= (1 << (y & 7));
      break;
   case BLACK:
      buffer[x + (y / 8) * SSD1306_LCDWIDTH] &= ~(1 << (y & 7));
      break;
   case INVERSE:
      buffer[x + (y / 8) * SSD1306_LCDWIDTH] ^= (1 << (y & 7));
      break;
   }
}
