//================================================================================================//
//                                                                                                //
// PROJET       : DongleWifi GoodRace                                                             //
// MODULE       : Board                                                                           //
// DESCRIPTION  :                                                                                 //
// CREATION     : 27/01/2020                                                                      //
// HISTORIQUE   :                                                                                 //
//                                                                                                //
//================================================================================================//

//================================================================================================//
//                                        FICHIERS INCLUS                                         //
//================================================================================================//

#include "./plip.h"

//================================================================================================//
//                                            DEFINES                                             //
//================================================================================================//

//================================================================================================//
//                                          ENUMERATIONS                                          //
//================================================================================================//

//================================================================================================//
//                                      STRUCTURES ET UNIONS                                      //
//================================================================================================//

////////////////////////////////////////////////////////////////////////////////////////////////////
//                                 VARIABLES PRIVEES ET PARTAGEES                                 //
////////////////////////////////////////////////////////////////////////////////////////////////////

//------------------------------------------------------------------------------------------------//
//---                                         Privees                                          ---//
//------------------------------------------------------------------------------------------------//
static bool bits[3][24];
volatile bool trigger = false;
static uint16_t nbBits = 0;
static uint8_t frameNumber = 0;
static bool success = false;
static unsigned long _ms = millis();

//------------------------------------------------------------------------------------------------//
//---                                        Partagees                                         ---//
//------------------------------------------------------------------------------------------------//

////////////////////////////////////////////////////////////////////////////////////////////////////
//                                 FONCTIONS PRIVEES ET PARTAGEES                                 //
////////////////////////////////////////////////////////////////////////////////////////////////////

//------------------------------------------------------------------------------------------------//
//---                                         Privees                                          ---//
//------------------------------------------------------------------------------------------------//
void _ISR() // ISR function excutes when push button at pinD2 is pressed
{
    trigger = true;
}

int8_t decode(uint8_t idx)
{
    int8_t val = -1;
    bool bit0 = bits[0][(idx * 2)];
    bool bit1 = bits[0][(idx * 2) + 1];

    if ((bit0 == true) && (bit1 == false))
    {
        val = 0;
    }
    else if ((bit0 == true) && (bit1 == true))
    {
        val = 1;
    }

    return val;
}

uint8_t decode_2(int8_t E0, int8_t E1)
{
    uint8_t val = 9;
    if (E0 == 0 && E1 == 0)
    {
        val = 4;
    }
    else if (E0 == -1 && E1 == 0)
    {
        val = 1;
    }
    else if (E0 == 1 && E1 == 0)
    {
        val = 7;
    }
    else if (E0 == 0 && E1 == -1)
    {
        val = 3;
    }
    else if (E0 == -1 && E1 == -1)
    {
        val = 0;
    }
    else if (E0 == 1 && E1 == -1)
    {
        val = 6;
    }
    else if (E0 == 0 && E1 == 1)
    {
        val = 5;
    }
    else if (E0 == -1 && E1 == 1)
    {
        val = 2;
    }
    else if (E0 == 1 && E1 == 1)
    {
        val = 8;
    }
    return val;
}

//------------------------------------------------------------------------------------------------//
//---                                        Partagees                                         ---//
//------------------------------------------------------------------------------------------------//

//--------------------------------------------------------------------------------------------------
// FONCTION    : COMPC_TaskInit
//
// DESCRIPTION : Initialisation de la carte : GPIO, Clocks, Interruptions...
//--------------------------------------------------------------------------------------------------
bool PLIP_TaskInit(void)
{
    trigger = false;
    success = false;
    nbBits = 0;
    frameNumber = 0;
    _ms = millis();

    attachInterrupt(digitalPinToInterrupt(3), _ISR, RISING);
}

bool PLIP_TaskRun(void)
{
    if (trigger == true)
    {
        trigger = false;
        delayMicroseconds(1250);
        bits[frameNumber][nbBits] = !trigger;

        nbBits++;
        if (nbBits >= 24)
        {
            nbBits = 0;
            frameNumber++;
        }
        _ms = millis();
        trigger = false;
    }

    if ((millis() - _ms) >= 100)
    {
        if (frameNumber >= 3)
        {
            success = true;
            for (int i = 0; i < 24; i++)
            {
                if ((bits[0][i] != bits[1][i]) || (bits[0][i] != bits[2][i]) || (bits[1][i] != bits[2][i]))
                {
                    success = false;
                }
            }
            
            if ( success ){
                return true;
            }
        }
    }

    return false;
}

uint16_t PLIP_GetCode(void){
    uint16_t val = 0;
    for (int i = 0; i < 10; i += 2)
    {
        val*=10;
        val += decode_2(decode(i), decode(i+1));
    }
    return val;
}