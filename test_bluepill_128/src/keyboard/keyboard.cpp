//================================================================================================//
//                                                                                                //
// PROJET       : DongleWifi GoodRace                                                             //
// MODULE       : Board                                                                           //
// DESCRIPTION  :                                                                                 //
// CREATION     : 27/01/2020                                                                      //
// HISTORIQUE   :                                                                                 //
//                                                                                                //
//================================================================================================//

//================================================================================================//
//                                        FICHIERS INCLUS                                         //
//================================================================================================//

#include "keyboard.h"

//================================================================================================//
//                                            DEFINES                                             //
//================================================================================================//

//================================================================================================//
//                                          ENUMERATIONS                                          //
//================================================================================================//

//================================================================================================//
//                                      STRUCTURES ET UNIONS                                      //
//================================================================================================//

////////////////////////////////////////////////////////////////////////////////////////////////////
//                                 VARIABLES PRIVEES ET PARTAGEES                                 //
////////////////////////////////////////////////////////////////////////////////////////////////////

//------------------------------------------------------------------------------------------------//
//---                                         Privees                                          ---//
//------------------------------------------------------------------------------------------------//
static bool _pushed = false;
static bool _longPush = false;
static bool _smallPush = false;
static unsigned long _ms = millis();

//------------------------------------------------------------------------------------------------//
//---                                        Partagees                                         ---//
//------------------------------------------------------------------------------------------------//

////////////////////////////////////////////////////////////////////////////////////////////////////
//                                 FONCTIONS PRIVEES ET PARTAGEES                                 //
////////////////////////////////////////////////////////////////////////////////////////////////////

//------------------------------------------------------------------------------------------------//
//---                                         Privees                                          ---//
//------------------------------------------------------------------------------------------------//

//------------------------------------------------------------------------------------------------//
//---                                        Partagees                                         ---//
//------------------------------------------------------------------------------------------------//

//--------------------------------------------------------------------------------------------------
// FONCTION    : KEYBOARD_Init
//
// DESCRIPTION : Initialisation de la carte : GPIO, Clocks, Interruptions...
//--------------------------------------------------------------------------------------------------
bool KEYBOARD_TaskInit(void)
{
    _pushed = false;
    _longPush = false;
    _ms = millis();
    return true;
}

void KEYBOARD_TaskRun(void)
{

    if ((GPIO_BUTTON_VAL() == false))
    {
        if (_pushed == false)
        {
            _ms = millis();
        }
        _pushed = true;
        if ((millis() - _ms) >= 3000)
        {
            if (_longPush == false)
            {
                s_KEYB_EVENT key;
                key.code = 1;
                key.isLong = true;
                EVENT_Push(SCREEN_TASK_ID, KEYB_EVENT,&key);
            }
            _longPush = true;
        }
    }
    else
    {
        if (_pushed && !_longPush)
        {
            _smallPush = true;
            s_KEYB_EVENT key;
            key.code = 1;
            key.isLong = false;
            EVENT_Push(SCREEN_TASK_ID, KEYB_EVENT,&key);
        }
        _pushed = false;
        _longPush = false;
    }
}

bool KEYBOARD_IsPushed(void)
{
    return _pushed;
}

bool KEYBOARD_IsLongPush(void)
{
    return _longPush;
}

bool KEYBOARD_IsSmallPush(void)
{
    return _smallPush;
}

void KEYBOARD_Clear(void)
{
    _longPush = false;
    _smallPush = false;
}