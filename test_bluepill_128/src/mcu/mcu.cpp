//================================================================================================//
//                                                                                                //
// PROJET       : DongleWifi GoodRace                                                             //
// MODULE       : Board                                                                           //
// DESCRIPTION  :                                                                                 //
// CREATION     : 27/01/2020                                                                      //
// HISTORIQUE   :                                                                                 //
//                                                                                                //
//================================================================================================//

//================================================================================================//
//                                        FICHIERS INCLUS                                         //
//================================================================================================//

#include "./mcu.h"

//================================================================================================//
//                                            DEFINES                                             //
//================================================================================================//

//================================================================================================//
//                                          ENUMERATIONS                                          //
//================================================================================================//

//================================================================================================//
//                                      STRUCTURES ET UNIONS                                      //
//================================================================================================//

////////////////////////////////////////////////////////////////////////////////////////////////////
//                                 VARIABLES PRIVEES ET PARTAGEES                                 //
////////////////////////////////////////////////////////////////////////////////////////////////////

//------------------------------------------------------------------------------------------------//
//---                                         Privees                                          ---//
//------------------------------------------------------------------------------------------------//
SoftwareSerial serialMCU(PA3, PA3);

const uint8_t bootStrap[256] PROGMEM = {0x8E, 0x00, 0xFF, 0xCE, 0x10, 0x00, 0x1C, 0x2D, 0x20, 0x6F, 0x35, 0x9D, 0x80,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 0x00, 0x00};

static e_MCU _e_mcu = MCU_IDLE;

//------------------------------------------------------------------------------------------------//
//---                                        Partagees                                         ---//
//------------------------------------------------------------------------------------------------//

////////////////////////////////////////////////////////////////////////////////////////////////////
//                                 FONCTIONS PRIVEES ET PARTAGEES                                 //
////////////////////////////////////////////////////////////////////////////////////////////////////

//------------------------------------------------------------------------------------------------//
//---                                         Privees                                          ---//
//------------------------------------------------------------------------------------------------//
void _mcuReset(void)
{
    GPIO_MCU_RESET_ON();
    delay(100);
    GPIO_MCU_RESET_OFF();
    delay(100);
    GPIO_MCU_RESET_ON();
    delay(100);
    serialMCU.write(0xFF);
    serialMCU.flush();
}

//------------------------------------------------------------------------------------------------//
//---                                        Partagees                                         ---//
//------------------------------------------------------------------------------------------------//

//--------------------------------------------------------------------------------------------------
// FONCTION    : COMPC_TaskInit
//
// DESCRIPTION : Initialisation de la carte : GPIO, Clocks, Interruptions...
//--------------------------------------------------------------------------------------------------
bool MCU_TaskInit(void)
{
    serialMCU.begin(1200);
    return true;
}

bool MCU_TaskUpdate(void *p)
{
    s_EVENT *event = (s_EVENT *)p;
    if (event->type & MCU_EVENT)
    {
        _e_mcu = (e_MCU)event->mcu.state;
        EVENT_Clear(MCU_TASK_ID, MCU_EVENT);
    }
    return true;
}

void MCU_TaskRun(void)
{
    switch (_e_mcu)
    {
    case (MCU_IDLE):
    {
        break;
    }
    case (MCU_LOAD_LOADER):
    {
        unsigned long _ms = millis();
        uint8_t nbError = 0;

        //-- send bootstrap
        for (int i = 0; i < 256; i++)
        {
            _ms = millis();
            serialMCU.write(bootStrap[i]);
            while (serialMCU.available() == false){
                if ( (millis() - _ms) > 100 ){
                    nbError++;
                    if ( nbError >= 30 ){
                        s_MCU_EVENT ev;
                        ev.state = MCU_ERROR;
                        EVENT_Push(SCREEN_TASK_ID , MCU_EVENT , &ev);
                        _e_mcu = MCU_IDLE;
                        return;
                    }
                     _ms = millis();
                }  
            }
            int data = serialMCU.read();
            _ms = millis();
        }
        _e_mcu = MCU_IDLE;
        break;
    }
    }
}
