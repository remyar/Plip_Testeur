//================================================================================================//
//                                                                                                //
// PROJET       : DongleWifi GoodRace                                                             //
// MODULE       : Board                                                                           //
// DESCRIPTION  :                                                                                 //
// CREATION     : 27/01/2020                                                                      //
// HISTORIQUE   :                                                                                 //
//                                                                                                //
//================================================================================================//

//================================================================================================//
//                                        FICHIERS INCLUS                                         //
//================================================================================================//

#include "./COM_PC.h"
#include "../screen/screen.h"

//================================================================================================//
//                                            DEFINES                                             //
//================================================================================================//

//================================================================================================//
//                                          ENUMERATIONS                                          //
//================================================================================================//

//================================================================================================//
//                                      STRUCTURES ET UNIONS                                      //
//================================================================================================//

////////////////////////////////////////////////////////////////////////////////////////////////////
//                                 VARIABLES PRIVEES ET PARTAGEES                                 //
////////////////////////////////////////////////////////////////////////////////////////////////////

//------------------------------------------------------------------------------------------------//
//---                                         Privees                                          ---//
//------------------------------------------------------------------------------------------------//
String _sCmd = "";
bool remoteMode = false;

//------------------------------------------------------------------------------------------------//
//---                                        Partagees                                         ---//
//------------------------------------------------------------------------------------------------//

////////////////////////////////////////////////////////////////////////////////////////////////////
//                                 FONCTIONS PRIVEES ET PARTAGEES                                 //
////////////////////////////////////////////////////////////////////////////////////////////////////

//------------------------------------------------------------------------------------------------//
//---                                         Privees                                          ---//
//------------------------------------------------------------------------------------------------//
void _processCommand(String cmd){
    while ((cmd.length() > 0) && (cmd.startsWith("[") == false))
    {
        cmd.remove(0, 1);
    }
    if (cmd.startsWith("[") == true){

        cmd.remove(0, 1);

        if ( cmd.startsWith("REMOTE") ){
            remoteMode = true;
            s_DISPLAY_EVENT ev;
            ev.index = SCREEN_REMOTE;
            EVENT_Push(SCREEN_TASK_ID, DISPLAY_EVENT,&ev);
        }
        if ( cmd.startsWith("UNREMOTE") ){
            remoteMode = false;
            s_DISPLAY_EVENT ev;
            ev.index = SCREEN_UNREMOTE;
            EVENT_Push(SCREEN_TASK_ID, DISPLAY_EVENT,&ev);
        }


        if ( remoteMode == true ){

        } else {

        }

        while (cmd.startsWith("]") == false)
        {
            cmd.remove(0, 1);
        }

        //-- remove ']'
        cmd.remove(0, 1); 
    }
}

//------------------------------------------------------------------------------------------------//
//---                                        Partagees                                         ---//
//------------------------------------------------------------------------------------------------//

//--------------------------------------------------------------------------------------------------
// FONCTION    : COMPC_TaskInit
//
// DESCRIPTION : Initialisation de la carte : GPIO, Clocks, Interruptions...
//--------------------------------------------------------------------------------------------------
bool COMPC_TaskInit(void)
{
    SerialUSB.begin(115200);
    return true;
}

bool COMPC_TaskUpdate(void *p)
{
    s_EVENT *event = (s_EVENT *)p;
    
    return true;
}

void COMPC_TaskRun(void)
{
    if (SerialUSB.available() > 0)
    {
        _sCmd += (char)SerialUSB.read();
    }

    if (_sCmd.endsWith("]"))
    {
        _processCommand(_sCmd);
        _sCmd = "";
    }
}
